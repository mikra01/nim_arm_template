/* Script for -z combreloc: combine and sort reloc sections */
/* Copyright (C) 2014-2019 Free Software Foundation, Inc.
   Copying and distribution of this script, with or without modification,
   are permitted in any medium without royalty provided the copyright
   notice and this notice are preserved.  */
/* default linker script generated with arm-none-eabi-ld --verbose */
/* comments marked with "extra:" which denote the adjustments */
OUTPUT_FORMAT("elf32-littlearm", "elf32-bigarm",
              "elf32-littlearm")
OUTPUT_ARCH(arm)
MEMORY
{
  rom      (rx)  : ORIGIN = 0x34000000, LENGTH = 0x00100000
  sram      (rwx) : ORIGIN = 0x00000000, LENGTH = 0x00010000
  ram      (rwx) : ORIGIN = 0x00010000, LENGTH = 0x00040000
}
ENTRY(_start)
/* GROUP( startup.o libc_nano.a ) */   /* extra: seems that --start-group --end-group not supported on osx so we put it here */
SECTIONS
{
  /* Read-only sections, merged into text segment: */
  PROVIDE (__executable_start = SEGMENT_START("text-segment",  0x10000)); . = SEGMENT_START("text-segment", 0x10000);
   /* extra: SEGMENT_START adjusted to 0x10000 for qemu */
  .note.gnu.build-id  : { *(.note.gnu.build-id) }
  .hash           : { *(.hash) }
  .gnu.hash       : { *(.gnu.hash) }
  .dynsym         : { *(.dynsym) }
  .dynstr         : { *(.dynstr) }
  .gnu.version    : { *(.gnu.version) }
  .gnu.version_d  : { *(.gnu.version_d) }
  .gnu.version_r  : { *(.gnu.version_r) }
  .rel.dyn        :
    {
      *(.rel.init)
      *(.rel.text .rel.text.* .rel.gnu.linkonce.t.*)
      *(.rel.fini)
      *(.rel.rodata .rel.rodata.* .rel.gnu.linkonce.r.*)
      *(.rel.data.rel.ro .rel.data.rel.ro.* .rel.gnu.linkonce.d.rel.ro.*)
      *(.rel.data .rel.data.* .rel.gnu.linkonce.d.*)
      *(.rel.tdata .rel.tdata.* .rel.gnu.linkonce.td.*)
      *(.rel.tbss .rel.tbss.* .rel.gnu.linkonce.tb.*)
      *(.rel.ctors)
      *(.rel.dtors)
      *(.rel.got)
      *(.rel.bss .rel.bss.* .rel.gnu.linkonce.b.*)
      PROVIDE_HIDDEN (__rel_iplt_start = .);
      *(.rel.iplt)
      PROVIDE_HIDDEN (__rel_iplt_end = .);
    } > ram
  .rela.dyn       :
    {
      *(.rela.init)
      *(.rela.text .rela.text.* .rela.gnu.linkonce.t.*)
      *(.rela.fini)
      *(.rela.rodata .rela.rodata.* .rela.gnu.linkonce.r.*)
      *(.rela.data .rela.data.* .rela.gnu.linkonce.d.*)
      *(.rela.tdata .rela.tdata.* .rela.gnu.linkonce.td.*)
      *(.rela.tbss .rela.tbss.* .rela.gnu.linkonce.tb.*)
      *(.rela.ctors)
      *(.rela.dtors)
      *(.rela.got)
      *(.rela.bss .rela.bss.* .rela.gnu.linkonce.b.*)
      PROVIDE_HIDDEN (__rela_iplt_start = .);
      *(.rela.iplt)
      PROVIDE_HIDDEN (__rela_iplt_end = .);
    } > ram
  .rel.plt        :
    {
      *(.rel.plt)
    } > ram
  .rela.plt       :
    {
      *(.rela.plt)
    } > ram
  .init           :
  {
    KEEP (*(SORT_NONE(.init)))
  } > ram
  .plt            : { *(.plt) } > ram
  .iplt           : { *(.iplt) } > ram
  .text           :
  { startup.o
    /* *(EXCLUDE_FILE(*-signal*.o).text* .rodata .rodata* .constdata .constdata*) */
    *(.text.unlikely .text.*_unlikely .text.unlikely.*)
    *(.text.exit .text.exit.*)
    *(.text.startup .text.startup.*)
    *(.text.hot .text.hot.*)
    *(.text .stub .text.* .gnu.linkonce.t.*)
    /* .gnu.warning sections are handled specially by elf32.em.  */
    *(.gnu.warning)
    *(.glue_7t) *(.glue_7) *(.vfp11_veneer) *(.v4_bx)
  } > ram
  .fini           :
  {
    KEEP (*(SORT_NONE(.fini)))
  } > ram
  PROVIDE (__etext = .); /* start of reloc-data */
  PROVIDE (_etext = .);
  PROVIDE (etext = .);
  .rodata         : { *(.rodata .rodata.* .gnu.linkonce.r.*) } > ram
  .rodata1        : { *(.rodata1) } > ram
  .ARM.extab   : { *(.ARM.extab* .gnu.linkonce.armextab.*) } > ram
   PROVIDE_HIDDEN (__exidx_start = .);
  .ARM.exidx   : { *(.ARM.exidx* .gnu.linkonce.armexidx.*) } > ram
   PROVIDE_HIDDEN (__exidx_end = .);
  .eh_frame_hdr   : { *(.eh_frame_hdr) *(.eh_frame_entry .eh_frame_entry.*) } > ram
  .eh_frame       : ONLY_IF_RO { KEEP (*(.eh_frame)) *(.eh_frame.*) } > ram
  .gcc_except_table   : ONLY_IF_RO { *(.gcc_except_table .gcc_except_table.*) } > ram
  .gnu_extab   : ONLY_IF_RO { *(.gnu_extab*) } > ram
  /* These sections are generated by the Sun/Oracle C++ compiler.  */
  .exception_ranges   : ONLY_IF_RO { *(.exception_ranges*) } > ram
  /* Adjust the address for the data segment.  We want to adjust up to
     the same address within the page on the next page up.  */
  . = ALIGN(CONSTANT (MAXPAGESIZE)) + (. & (CONSTANT (MAXPAGESIZE) - 1));
  /* Exception handling  */
  .eh_frame       : ONLY_IF_RW { KEEP (*(.eh_frame)) *(.eh_frame.*) } > ram
  .gnu_extab      : ONLY_IF_RW { *(.gnu_extab) } > ram
  .gcc_except_table   : ONLY_IF_RW { *(.gcc_except_table .gcc_except_table.*) } > ram
  .exception_ranges   : ONLY_IF_RW { *(.exception_ranges*) } > ram
  /* Thread Local Storage sections  */
  .tdata          :
   {
     PROVIDE_HIDDEN (__tdata_start = .);
     *(.tdata .tdata.* .gnu.linkonce.td.*)
   } > ram
  .tbss           : { *(.tbss .tbss.* .gnu.linkonce.tb.*) *(.tcommon) } > ram
  .preinit_array    :
  {
    PROVIDE_HIDDEN (__preinit_array_start = .);
    KEEP (*(.preinit_array))
    PROVIDE_HIDDEN (__preinit_array_end = .);
  } > ram
  .init_array    :
  {
    PROVIDE_HIDDEN (__init_array_start = .);
    KEEP (*(SORT_BY_INIT_PRIORITY(.init_array.*) SORT_BY_INIT_PRIORITY(.ctors.*)))
    KEEP (*(.init_array EXCLUDE_FILE (*crtbegin.o *crtbegin?.o *crtend.o *crtend?.o ) .ctors))
    PROVIDE_HIDDEN (__init_array_end = .);
  } > ram
  .fini_array    :
  {
    PROVIDE_HIDDEN (__fini_array_start = .);
    KEEP (*(SORT_BY_INIT_PRIORITY(.fini_array.*) SORT_BY_INIT_PRIORITY(.dtors.*)))
    KEEP (*(.fini_array EXCLUDE_FILE (*crtbegin.o *crtbegin?.o *crtend.o *crtend?.o ) .dtors))
    PROVIDE_HIDDEN (__fini_array_end = .);
  } > ram
  .ctors          :
  {
    /* gcc uses crtbegin.o to find the start of
       the constructors, so we make sure it is
       first.  Because this is a wildcard, it
       doesn't matter if the user does not
       actually link against crtbegin.o; the
       linker won't look for a file to match a
       wildcard.  The wildcard also means that it
       doesn't matter which directory crtbegin.o
       is in.  */
    KEEP (*crtbegin.o(.ctors))
    KEEP (*crtbegin?.o(.ctors))
    /* We don't want to include the .ctor section from
       the crtend.o file until after the sorted ctors.
       The .ctor section from the crtend file contains the
       end of ctors marker and it must be last */
    KEEP (*(EXCLUDE_FILE (*crtend.o *crtend?.o ) .ctors))
    KEEP (*(SORT(.ctors.*)))
    KEEP (*(.ctors))
  } > ram
  .dtors          :
  {
    KEEP (*crtbegin.o(.dtors))
    KEEP (*crtbegin?.o(.dtors))
    KEEP (*(EXCLUDE_FILE (*crtend.o *crtend?.o ) .dtors))
    KEEP (*(SORT(.dtors.*)))
    KEEP (*(.dtors))
  } > ram
  .jcr            : { KEEP (*(.jcr)) } > ram
  .data.rel.ro : { *(.data.rel.ro.local* .gnu.linkonce.d.rel.ro.local.*) *(.data.rel.ro .data.rel.ro.* .gnu.linkonce.d.rel.ro.*) } > ram
  .dynamic        : { *(.dynamic) } > ram
  .got            : { *(.got.plt) *(.igot.plt) *(.got) *(.igot) } > ram
  .data           :
  {
    __data_start = .;
    *(.data .data.* .gnu.linkonce.d.*)
    SORT(CONSTRUCTORS)
  } > ram
  .data1          : { *(.data1) } > ram
  _edata = .; PROVIDE (edata = .);
  . = .;
  __bss_start = .;
  __bss_start__ = .;
  .bss            :
  {
   *(.dynbss)
   *(.bss .bss.* .gnu.linkonce.b.*)
   *(COMMON)
   /* Align here to ensure that the .bss section occupies space up to
      _end.  Align after .bss to ensure correct alignment even if the
      .bss section disappears because there are no input sections.
      FIXME: Why do we need it? When there is no .bss section, we do not
      pad the .data section.  */
   . = ALIGN(. != 0 ? 32 / 8 : 1);
  } > ram
  _bss_end__ = .; __bss_end__ = .;
  . = ALIGN(32 / 8);
  . = SEGMENT_START("ldata-segment", .);
  . = ALIGN(32 / 8);
  __end__ = .;
  _end = .; PROVIDE (end = .);
  .stack         0x80000 :
  {
    _stack = .;
    *(.stack)
  } > ram
  irq_stack_top = _stack + 0x10000;
  user_stack_top = irq_stack_top  + 0x10000;
  /* Stabs debugging sections.  */
  .stab          0 : { *(.stab) } > ram
  .stabstr       0 : { *(.stabstr) } > ram
  .stab.excl     0 : { *(.stab.excl) } > ram
  .stab.exclstr  0 : { *(.stab.exclstr) } > ram
  .stab.index    0 : { *(.stab.index) } > ram
  .stab.indexstr 0 : { *(.stab.indexstr) } > ram
  .comment       0 : { *(.comment) } > ram
  .gnu.build.attributes : { *(.gnu.build.attributes .gnu.build.attributes.*) } > ram
  /* DWARF debug sections.
     Symbols in the DWARF debugging sections are relative to the beginning
     of the section so we begin them at 0.  */
  /* DWARF 1 */
  .debug          0 : { *(.debug) } > ram
  .line           0 : { *(.line) } > ram
  /* GNU DWARF 1 extensions */
  .debug_srcinfo  0 : { *(.debug_srcinfo) } > ram
  .debug_sfnames  0 : { *(.debug_sfnames) } > ram
  /* DWARF 1.1 and DWARF 2 */
  .debug_aranges  0 : { *(.debug_aranges) } > ram
  .debug_pubnames 0 : { *(.debug_pubnames) } > ram
  /* DWARF 2 */
  .debug_info     0 : { *(.debug_info .gnu.linkonce.wi.*) } > ram
  .debug_abbrev   0 : { *(.debug_abbrev) } > ram
  .debug_line     0 : { *(.debug_line .debug_line.* .debug_line_end) } > ram
  .debug_frame    0 : { *(.debug_frame) } > ram
  .debug_str      0 : { *(.debug_str) } > ram
  .debug_loc      0 : { *(.debug_loc) } > ram
  .debug_macinfo  0 : { *(.debug_macinfo) } > ram
  /* SGI/MIPS DWARF 2 extensions */
  .debug_weaknames 0 : { *(.debug_weaknames) } > ram
  .debug_funcnames 0 : { *(.debug_funcnames) } > ram
  .debug_typenames 0 : { *(.debug_typenames) } > ram
  .debug_varnames  0 : { *(.debug_varnames) } > ram
  /* DWARF 3 */
  .debug_pubtypes 0 : { *(.debug_pubtypes) } > ram
  .debug_ranges   0 : { *(.debug_ranges) } > ram
  /* DWARF Extension.  */
  .debug_macro    0 : { *(.debug_macro) } > ram
  .debug_addr     0 : { *(.debug_addr) } > ram
  .ARM.attributes 0 : { KEEP (*(.ARM.attributes)) KEEP (*(.gnu.attributes)) } > ram
.note.gnu.arm.ident 0 : { KEEP (*(.note.gnu.arm.ident)) } > ram
/* This section contains data that is not initialised during load
   *or* application reset.  */
 .noinit (NOLOAD) :
 {
   . = ALIGN(2);
   PROVIDE (__noinit_start = .);
   *(.noinit)
   . = ALIGN(2);
   PROVIDE (__noinit_end = .);
 } > ram
  /DISCARD/ : { *(.note.GNU-stack) *(.gnu_debuglink) *(.gnu.lto_*) } > ram
}